## CMakeLists.txt
```
cmake_minimum_required(VERSION 3.20.0)
find_package(Zephyr REQUIRED HINTS $ENV{ZEPHYR_BASE})

project(ADS1299)

target_sources(app PRIVATE src/main.c)
```

## prj.conf
```kconfig
CONFIG_SPI=y
CONFIG_SPI_NRFX=y
CONFIG_NRFX_SPIM1=y
```

## src/main.c
```c
#include <zephyr/kernel.h>
#include <nrfx_spim.h>
#include <stdio.h>
#include "ads1299.h"

int main(void)
{       spi_init();
        uint8_t data_buffer[27] = {0};
        start_ads1299();
        while(1){
                read_data_ads1299(data_buffer, 27);
                for(int i=0;i<27;i++){
                        printf("%d ", data_buffer[i]);
                }
                printf("stop\n");
                k_sleep(K_SECONDS(1));
        }
        return 0;
}
```

## src/ads1299.c
```c
#include "ads1299.h"
#include "spi.h"

uint8_t read_ads1299_reg(uint8_t* buffer, uint8_t start, uint8_t size){
        uint8_t tx[2] = ADS1299_RREG_CMD(start, size);
        int err = spi_send_receive(tx,2,buffer,size);
        if (err != 0){
                return 1;
        }
        return 0;
}

void start_ads1299(){
        uint8_t tx = ADS1299_START_CMD;
        int err = spi_send_receive(&tx,1,NULL,0);
        if (err != 0){
                printf("spi err\n");
        }
}

uint8_t write_ads1299_reg(uint8_t* buffer, uint8_t start, uint8_t size){
        uint8_t tx_cmd[2] = ADS1299_WREG_CMD(start, size);
        uint8_t tx[2+size];
        memcpy(tx,tx_cmd,2);
        memcpy(tx+2,buffer,size);
        int err = spi_send_receive(tx,2+size,NULL,0);
        if (err != 0){
                printf("spi err\n");
        }
}

void read_data_ads1299(uint8_t* buffer, uint8_t size){
        uint8_t tx = ADS1299_RDATA_CMD;
        int err = spi_send_receive(&tx,1,buffer,size);
        if (err != 0){
                printf("spi err\n");
        }
}
```

## src/ads1299.h
```c
#include <zephyr.h>
#include  "ads1299_reg.h"

//System CMD
//wake-up from standby mode
#define ADS1299_WAKEUP_CMD 0x02
//enter standby mode
#define ADS1299_STANDBY_CMD 0x04
//reset the device
#define ADS1299_RESET_CMD 0x06
//start and restart(synchronize) conversions
#define ADS1299_START_CMD 0x08
//stop conversion
#define ADS1299_STOP_CMD 0x0A

//Data Read CMD
//default mode, enable read data continuous mode
#define ADS1299_RDATAC_CMD 0x10
//stop read ata continuously mode
#define ADS1299_SDATAC_CMD 0x11
//read tat by command
#define ADS1299_RDATA_CMD 0x12

//Register Read CMD
//start is the starting register address for read or write commands
//size is the number of reg want to read or write
#define ADS1299_RREG_CMD(start,size) {0b00100000 | start, size}
#define ADS1299_WREG_CMD(start,size) {0b01000000 | start, size}

uint8_t read_ads1299_reg(uint8_t*, uint8_t, uint8_t);

uint8_t write_ads1299_reg(uint8_t*, uint8_t, uint8_t);
```

## src/spi.c
```c
#include "spi.h"

#define ICM_SPIM_SCLK_PIN           (37)      //p1.05
#define ICM_SPIM_MOSI_PIN           (47)
#define ICM_SPIM_MISO_PIN           (45)
#define ICM_SPIM_SS_PIN             (43)

static const nrfx_spim_t spi_dev = NRFX_SPIM_INSTANCE(1);

void spi_init(void){
        nrfx_err_t err;
        nrfx_spim_uninit(&spi_dev);
        nrfx_spim_config_t config = NRFX_SPIM_DEFAULT_CONFIG(ICM_SPIM_SCLK_PIN,
                                                             ICM_SPIM_MOSI_PIN,
                                                             ICM_SPIM_MISO_PIN,
                                                             ICM_SPIM_SS_PIN);
        config.frequency = NRF_SPIM_FREQ_4M;
	    err = nrfx_spim_init(&spi_dev, &config, NULL, NULL);
	    if (err != NRFX_SUCCESS) {
		    printk("Failed to initialize ICM_SPI: 0x%0x\n", err);
		return ;
	    }
        printk("ICM_SPI_IINT SUCCESS");
}

uint8_t spi_send_receive(uint8_t * send_buf, size_t send_length, uint8_t * recv_buf, size_t recv_length){
        int err = 0;

        nrfx_spim_xfer_desc_t xfer_desc = NRFX_SPIM_XFER_TRX(send_buf, send_length, recv_buf, recv_length);

        err = nrfx_spim_xfer(&spi_dev, &xfer_desc, 0);
        if (err != NRFX_SUCCESS) {
            printk("ICM_SPI transfer FAIL: 0x%0x\n", err);
            return 1;
	    }
        return 0;
}
```

## src/spi.h
```c
#include <zephyr/kernel.h>
#include <nrfx_spim.h>
#include <stdio.h>

void spi_init(void);
uint8_t spi_send_receive(uint8_t * send_buf, size_t send_length, uint8_t * recv_buf, size_t recv_length);
```

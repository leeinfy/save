## CMakeLists.txt
```
# SPDX-License-Identifier: Apache-2.0

cmake_minimum_required(VERSION 3.20.0)

find_package(Zephyr REQUIRED HINTS $ENV{ZEPHYR_BASE})
project(BLE_ADC)

target_sources(app PRIVATE src/main.c
                           src/saadc.c
                           src/timer.c
                           src/ble.c
                           src/ble_data_buf.c
                           src/ble_send.c
                           src/ble_receive.c)
```

## prj.conf
```kconfig
#ADC
CONFIG_ADC=y
CONFIG_NRFX_SAADC=y
CONFIG_ADC_NRFX_SAADC=y

#LOG
CONFIG_LOG=y
CONFIG_LOG_DEFAULT_LEVEL=3
CONFIG_LOG_MODE_DEFERRED=y

#TIMER
CONFIG_NRFX_TIMER0=y

#Button and LED library of Developing kit
CONFIG_DK_LIBRARY=y

#float point
CONFIG_FPU=y

#bluetooth
CONFIG_BT=y
CONFIG_BT_PERIPHERAL=y
CONFIG_BT_DEVICE_NAME="NRF_BLE_ADC"
CONFIG_BT_USER_PHY_UPDATE=y
CONFIG_BT_GATT_CLIENT=y
CONFIG_BT_USER_DATA_LEN_UPDATE=y
CONFIG_BT_BUF_ACL_RX_SIZE=251
CONFIG_BT_BUF_ACL_TX_SIZE=251
CONFIG_BT_L2CAP_TX_MTU=247
CONFIG_BT_ATT_PREPARE_COUNT=2 
CONFIG_BT_BUF_ACL_TX_COUNT=10

#Bluetooth NORDIC UART Service
CONFIG_BT_NUS=y

CONFIG_SYSTEM_WORKQUEUE_STACK_SIZE=2048
CONFIG_MAIN_STACK_SIZE=4096
CONFIG_NUM_PREEMPT_PRIORITIES=0
CONFIG_HEAP_MEM_POOL_SIZE=2048
```

## src/main.c
```c
/*
 * Copyright (c) 2012-2014 Wind River Systems, Inc.
 *
 * SPDX-License-Identifier: Apache-2.0
 */

#include <zephyr.h>

#include "saadc.h"
#include "timer.h"
#include "ble_data_buf.h"
#include "ble.h"
#include "ble_send.h"
#include "ble_receive.h"

#include <logging/log.h>
LOG_MODULE_REGISTER(main, CONFIG_LOG_DEFAULT_LEVEL);

void main(void){

	timer_init_app();
	saadc_init_app();
	init_ble_app();

	init_ble_send_app();
	timer_start_app();
}

K_THREAD_DEFINE(ble_data_send_thread, 1024, ble_data_send_thread_func, NULL, NULL, NULL, -10, 0, 0);

K_THREAD_DEFINE(ble_host_command, 1024, process_host_command_thread, NULL, NULL, NULL, -11, 0, 0);
```

## src/ble.c
```c
#include "ble.h"

#include <logging/log.h>
LOG_MODULE_REGISTER(ble, CONFIG_LOG_DEFAULT_LEVEL);

//advertising data
static const struct bt_data ad_data [] = {
    BT_DATA_BYTES(BT_DATA_FLAGS, BT_LE_AD_NO_BREDR),
    BT_DATA(BT_DATA_NAME_COMPLETE, CONFIG_BT_DEVICE_NAME, sizeof(CONFIG_BT_DEVICE_NAME)-1),
} ;

struct bt_conn* client = NULL;

static ble_app_t  ble_priv_app;

K_MSGQ_DEFINE(host_command_msgq, sizeof(host_command_t), 10, 1);
 
//set up ble configurate variables
static void ble_app_priv_set(void){
    ble_priv_app.adv_param =  *BT_LE_ADV_CONN;
    ble_priv_app.conn_param = *BT_LE_CONN_PARAM_DEFAULT;
    ble_priv_app.phy_param = *BT_CONN_LE_PHY_PARAM(BT_GAP_LE_PHY_2M,BT_GAP_LE_PHY_2M);
    ble_priv_app.nus_service_enabled = 0;
}

//on connected callback function
static void on_connected_cb (struct bt_conn *conn, uint8_t err){
    if (err != 0){
        LOG_ERR("bluetoth connection error (%u)", err);
        return;
    }
    client = bt_conn_ref(conn);
    LOG_INF("bluetooth client connected");
    dk_set_led_on(DK_LED1);

    int error;
    error = bt_conn_le_phy_update(conn, &ble_priv_app.phy_param);
    if (error != 0){
        LOG_ERR("bluetooth phy update fail (%d)", error);
    }

    error = bt_conn_le_data_len_update(conn, &ble_priv_app.data_len_param);
    if (error != 0){
        LOG_ERR("bluetotth data len update fail (%d)", error);
    }
}

//on disconnected callback function
static void on_disconnected_cb (struct bt_conn *conn, uint8_t reason){
    bt_conn_unref(conn);
    LOG_INF("bluetooth client disconnected reason(%u)", reason);
}

//on connection param update callback function
static void on_conn_param_updated_cb (struct bt_conn *conn, uint16_t interval, uint16_t latency, uint16_t timeout){
    double connection_interval = interval*1.25;
    uint16_t supervision_timeout = timeout*10;
    LOG_INF("connection parameters update: interval %.2f ms, latency %d intervals, timeout %d ms", connection_interval, latency, supervision_timeout);
}

static const char *phy2str(uint8_t phy)
{
	switch (phy) {
	case 0: return "No packets";
	case BT_GAP_LE_PHY_1M: return "LE 1M";
	case BT_GAP_LE_PHY_2M: return "LE 2M";
	case BT_GAP_LE_PHY_CODED: return "LE Coded";
	default: return "Unknown";
	}
}

//On phy updated callback function
static void on_phy_updated_cb (struct bt_conn *conn, struct bt_conn_le_phy_info * param){
    LOG_INF("LE PHY updated: TX PHY %s, RX PHY %s\n", phy2str(param->tx_phy), phy2str(param->rx_phy));
}

static void on_data_len_updated_cb(struct bt_conn *conn, struct bt_conn_le_data_len_info *info){
    LOG_INF("LE data len updated: TX (len: %d time: %d)"
	       " RX (len: %d time: %d)\n", info->tx_max_len,
	       info->tx_max_time, info->rx_max_len, info->rx_max_time);
}

//connection call back register
static struct bt_conn_cb ble_conn_cb = {
    .connected = on_connected_cb,
    .disconnected = on_disconnected_cb,
    .le_param_updated = on_conn_param_updated_cb,
    .le_phy_updated = on_phy_updated_cb,
    .le_data_len_updated = on_data_len_updated_cb,
};

static void nus_send_enabled(enum bt_nus_send_status status){
    ble_priv_app.nus_service_enabled = 1;
    LOG_DBG("NUS services is subscribed");
}

static void nus_received(struct bt_conn *conn, const uint8_t* const data, uint16_t len){
    host_command_t host_msg = {
        .command = data[0],
        .value = data[1],
    };
    k_msgq_put(&host_command_msgq, &host_msg, K_NO_WAIT);
    LOG_DBG("NUS message received and push to message queue");
}

static struct bt_nus_cb nus_cb ={
    .send_enabled = nus_send_enabled,
    .received = nus_received,
};


void init_ble_app(void){
    ble_app_priv_set();    
    int err;
    //enable the bluetooth module
    err = bt_enable(NULL);
    if (err !=0){
        LOG_ERR("bt_enable err (%x)", err);
    }

    //wait for the bluetooth device to get ready
    while(!bt_is_ready()){
        k_sleep(K_MSEC(1));
    }

    //assign a connection callback register
    bt_conn_cb_register(&ble_conn_cb);

    err = bt_nus_init(&nus_cb);
    if (err != 0){
        LOG_ERR("bt_nus_init error (%x)", err);
    }

    //start advertising with default connectable advertising param 
    err = bt_le_adv_start(&ble_priv_app.adv_param, ad_data, ARRAY_SIZE(ad_data), NULL, 0);
    if (err !=0){
        LOG_ERR("bt_le_adv_start err (%x)", err);
    }
    LOG_INF("bluetooth initilization SUCCESS");
}

void ble_test_send(void){
    uint8_t data = 0;
    while (1){
        if (ble_priv_app.nus_service_enabled){
            bt_nus_send(client, &data, 1);
        }
        data++;
        k_sleep(K_SECONDS(1));
    }
}
```

## src/ble.h
```c
#pragma once
#include <bluetooth/bluetooth.h>
#include <bluetooth/gap.h>
#include <bluetooth/conn.h>
#include <bluetooth/services/nus.h>
#include <dk_buttons_and_leds.h>

typedef struct{
    struct bt_le_adv_param adv_param;
    struct bt_le_conn_param conn_param;
    struct bt_conn_le_phy_param phy_param;
    struct bt_conn_le_data_len_param data_len_param;
    bool nus_service_enabled;
    void (*received) (struct bt_conn *conn, const uint8_t * const data, uint16_t len);
}ble_app_t;

extern struct bt_conn* client;

typedef struct __attribute__((packed,aligned(1))) {
    uint8_t command;
    uint8_t value;
}host_command_t;

/*@brief start the bluetooth advertising on application layer
*/
void init_ble_app(void);

void ble_test_send();
```

## src/ble_data_buf.c
```c
#include "ble_data_buf.h"
#include <logging/log.h>

//ble data buffer log module setup
LOG_MODULE_REGISTER(ble_data_buf, CONFIG_LOG_DEFAULT_LEVEL);

ring_data_buffer_t ring_data_buffer;

data_buffer_t* init_data_buffer(void){
    memset(&ring_data_buffer, 0, sizeof(ring_data_buffer_t));
    ring_data_buffer.buffer[0].status = IN_USE;
    return &ring_data_buffer.buffer[0];
}

data_buffer_t* write_data_buffer(data_buffer_t* buffer, uint16_t data){
    if (buffer->data_count < STORAGE_BUFFER_SIZE ){
        buffer->data[buffer->data_count] = data;
        buffer->data_count = buffer->data_count + 1;
    }
    if (buffer->data_count == STORAGE_BUFFER_SIZE){   
        buffer->status = FULL;
        uint8_t next_idle_buffer = ring_data_buffer.current_buffer_in_use;
        for(int i=0; i<NUM_OF_BUFFER; i++){
            next_idle_buffer = (next_idle_buffer + 1) % NUM_OF_BUFFER;
            if (ring_data_buffer.buffer[next_idle_buffer].status == IDLE){
                ring_data_buffer.buffer[next_idle_buffer].status = IN_USE;
                ring_data_buffer.current_buffer_in_use = next_idle_buffer;
                return &ring_data_buffer.buffer[next_idle_buffer];
            }
        }
        LOG_ERR("no storage avaliable");
    }
    return buffer;
}

void clear_data_buffer(data_buffer_t* buffer){
    memset(buffer, 0, sizeof(data_buffer_t));
}

data_buffer_t* get_full_buffer(void){
    for(int i=0; i<NUM_OF_BUFFER; i++){
        if (ring_data_buffer.buffer[i].status == FULL){
            return &ring_data_buffer.buffer[i];
        }
    }
    return NULL;
}
```

## src/ble_data_buf.h
```c
#pragma once
#include <zephyr.h>
#include <string.h>
// the storage size is set to equal to BLE NUS service MTU
#define STORAGE_BUFFER_SIZE 120

//the variable type is depend on the adc resolution
typedef uint16_t data_buffer_storage_t[STORAGE_BUFFER_SIZE];

//need more than 1 buffer two form a ring buffer system
#define NUM_OF_BUFFER 2

typedef enum{
    IDLE = 0,
    IN_USE,
    FULL,
}data_buffer_status_t;

typedef struct{
    data_buffer_storage_t data;
    uint8_t data_count;
    data_buffer_status_t status;
    uint16_t data_offset;
}data_buffer_t;

typedef struct{
    data_buffer_t buffer[NUM_OF_BUFFER];
    uint8_t current_buffer_in_use;
}ring_data_buffer_t;

extern ring_data_buffer_t ring_data_buffer;

data_buffer_t* init_data_buffer(void);

/*@brief write the data to current data buffer
*/
data_buffer_t* write_data_buffer(data_buffer_t* buffer, uint16_t data);

void clear_data_buffer(data_buffer_t* buffer);

data_buffer_t* get_full_buffer(void);
```

## src/ble_receive.c
```c
#include "ble_receive.h"
#include <logging/log.h>
LOG_MODULE_REGISTER(host_command, CONFIG_LOG_DEFAULT_LEVEL);

void process_host_command_thread(void){
    host_command_t host_msg;
    while(1){
        k_msgq_get(&host_command_msgq, &host_msg, K_FOREVER);

        switch(host_msg.command){
            case ENABLE_ADC_SAMPLEING:{
                if(host_msg.value != ble_send_app.sampling_enabled) {
                    if (host_msg.value == 1) LOG_INF("enable sampling");
                    else if (host_msg.value == 0) LOG_INF("disable sampling");
                    ble_send_app.sampling_enabled = host_msg.value;
                }
                break;
            }
            default:{
                LOG_INF("Unknown host message");
                break;
            }
        }
    }
}
```

## src/ble_receive.h
```c
#pragma once
#include <zephyr.h>
#include "ble.h"
#include "ble_send.h"

extern struct k_msgq host_command_msgq;

enum host_valid_command{
    ENABLE_ADC_SAMPLEING = 1,
};

void process_host_command_thread(void);
```

## src/ble_send.c
```c
#include "ble_send.h"
#include <logging/log.h>
LOG_MODULE_REGISTER(ble_send, CONFIG_LOG_DEFAULT_LEVEL);

K_SEM_DEFINE(buffer_full_sem, 0, 16);

ble_send_thread_app_t ble_send_app;

static uint16_t ble_data_counter = 0;

static void ble_send_buffer(data_buffer_t* buffer){
    adc_protocol_t send_msg = {0};
    send_msg.data_length = 244;
    send_msg.sensor_index = 6;
    send_msg.data_offset = buffer->data_offset;
    memcpy(send_msg.data, buffer->data, BLE_DATA_LENGTH);
    bt_nus_send(client, (uint8_t *)&send_msg, 244);
    clear_data_buffer(buffer);
}

static void add_saadc_data_to_ble_buf(void){
    if (!ble_send_app.sampling_enabled) return;
    data_buffer_t* buffer = write_data_buffer(ble_send_app.p_buffer, get_saadc_data());
    ble_data_counter ++;
    //data_buffer_t* buffer = write_data_buffer(ble_send_app.p_buffer, test_counter++);
    if (buffer != ble_send_app.p_buffer){
        ble_send_app.p_buffer = buffer;
        buffer->data_offset = ble_data_counter;
        k_sem_give(&buffer_full_sem);
    }
}

void init_ble_send_app(void){
    ble_send_app.sampling_enabled = 0;
    ble_send_app.p_buffer = init_data_buffer();
    set_timer_app_cb(add_saadc_data_to_ble_buf);
}

void ble_data_send_thread_func (void){
    while(1){
        if (k_sem_take(&buffer_full_sem, K_FOREVER) != 0){
            continue;
        }
        data_buffer_t* full_buffer = get_full_buffer();
        ble_send_buffer(full_buffer);
    }
}
```

## src/ble_send.h
```c
#pragma once
#include <zephyr.h>
#include "saadc.h"
#include "timer.h"
#include "ble_data_buf.h"
#include "ble.h"
#include <stdio.h>

#define BLE_DATA_LENGTH 240

typedef struct{
    bool sampling_enabled;
    data_buffer_t* p_buffer;
}ble_send_thread_app_t;

extern ble_send_thread_app_t ble_send_app;

typedef struct{
    uint8_t  data_length;
    uint8_t sensor_index;
    uint16_t data_offset;
    uint8_t data[BLE_DATA_LENGTH];
}adc_protocol_t;

void init_ble_send_app(void);

void ble_data_send_thread_func (void);
```

## src/saadc.c
```c
#include "saadc.h"
#include <logging/log.h>

//saadc log module setup
LOG_MODULE_REGISTER(saadc, CONFIG_LOG_DEFAULT_LEVEL);

static nrf_saadc_value_t saadc_buffer[SAADC_BUFFER_SIZE] = {0};
// static nrf_saadc_value_t saadc_buffer2[SAADC_BUFFER_SIZE] = {0};

static saadc_app_t saadc_app_priv;

/*@brief set up the saadc parameter for the driver
*/
static void saadc_app_priv_set(void){
	//set saadc channel config, we only use 1 channel single end
	nrfx_saadc_channel_t saadc_channel_config = NRFX_SAADC_DEFAULT_CHANNEL_SE(NRF_SAADC_INPUT_AIN0,0);
	saadc_app_priv.channel[0] = saadc_channel_config;

	//set the channel mask
	saadc_app_priv.channel_mask = 0;
	for (int i=0;i<SAADC_CHANNEL_NUM_APP;i++){
		saadc_app_priv.channel_mask |= (1<<i);
	}

	//set the saadc resolution to 8 bit
	saadc_app_priv.resolution = NRF_SAADC_RESOLUTION_14BIT;

	//disable oversampling
	saadc_app_priv.oversampling = NRF_SAADC_OVERSAMPLE_DISABLED;

	//set saadc default interrupt priority
	saadc_app_priv.irq_priority = NRFX_SAADC_DEFAULT_CONFIG_IRQ_PRIORITY;
}

// static void nrfx_saadc_event_handler(nrfx_saadc_evt_t const *p_event){
// }

void saadc_init_app(void){
	saadc_app_priv_set();

	nrfx_err_t err;

	err = nrfx_saadc_init(saadc_app_priv.irq_priority);
	if (err != NRFX_SUCCESS){
		LOG_ERR("nrfx_saadc_init err(%x)", err);
	}

	for (int i=0;i<SAADC_CHANNEL_NUM_APP;i++){
		err = nrfx_saadc_channel_config(&saadc_app_priv.channel[i]);
		if (err != NRFX_SUCCESS){
			LOG_ERR("nrfx_saadc_channel(%d)_config err(%x)", i, err);
			return;
		}
	}

	//set up the saadc in simple mode, use blocking manner
	err = nrfx_saadc_simple_mode_set(saadc_app_priv.channel_mask, saadc_app_priv.resolution, saadc_app_priv.oversampling, NULL);
	if (err != NRFX_SUCCESS){
		LOG_ERR("nrfx_saadc_simple_mode_set err(%x)", err);
		return;
	}

	//set up buffer 1 and 2 for double buffered conversions
	err = nrfx_saadc_buffer_set(saadc_buffer, SAADC_BUFFER_SIZE);
	if (err != NRFX_SUCCESS){
		LOG_ERR("nrfx_saadc_buffer1_set err(%x)", err);
		return;
	}
	//only 1 buffer is needed for blocking manner
	// err = nrfx_saadc_buffer_set(saadc_buffer2, SAADC_BUFFER_SIZE);
	// if (err != NRFX_SUCCESS){
	// 	LOG_DBG("nrfx_saadc_buffer2_set err(%x)", err);
	// 	return;
	// }

	LOG_INF("saadc initialization SUCCESS");
}

uint16_t get_saadc_data (void){
	nrfx_saadc_mode_trigger();
	return saadc_buffer[0];
}

void saadc_test(void){
	saadc_init_app();

	while(1){
		nrfx_saadc_mode_trigger();
		LOG_INF("BUFFER 1 (%u)", saadc_buffer[0]);
		// LOG_INF("BUFFER 2 (%u)", saadc_buffer2[0]);
		k_sleep(K_SECONDS(1));
	}
	
}
```

## src/saadc.h
```c
#pragma once
#include <zephyr.h>
#include <nrfx_saadc.h>

#define SAADC_CHANNEL_NUM_APP 	1
//the buffer size is equal to number of enable channel
#define SAADC_BUFFER_SIZE		SAADC_CHANNEL_NUM_APP

typedef struct{
	nrfx_saadc_channel_t channel[SAADC_CHANNEL_NUM_APP];
	uint8_t channel_mask;
	nrf_saadc_resolution_t resolution;
	nrf_saadc_oversample_t oversampling;
	nrfx_saadc_adv_config_t adv_config;
	uint8_t irq_priority; 
}saadc_app_t;

/*@brief init saadc for the application
*/
void saadc_init_app(void);

/*@biref trigger one sampling and return saadd data from the data buffer
*/
uint16_t get_saadc_data (void);

/*@brief use to test the saddc module
 *capture and display the data
*/
void saadc_test(void);
```

## src/timer.c
```c
#include "timer.h"
#include <logging/log.h>

//saadc log module setup
LOG_MODULE_REGISTER(timer, CONFIG_LOG_DEFAULT_LEVEL);

//enable this when testing the timer
#include <zephyr/drivers/gpio.h>
#define GPIO_PIN 26
const struct device* gpio0_dev = DEVICE_DT_GET(DT_NODELABEL(gpio0));
////////////////////

static const nrfx_timer_t timer0_instance = NRFX_TIMER_INSTANCE(0);

static timer_app_t timer0_app_priv;

/*@biref set up the timer parameter 
*/
static void timer_app_priv_set(void){
    //set timer configurate to default
    nrfx_timer_config_t timer_default_config = NRFX_TIMER_DEFAULT_CONFIG;
    timer0_app_priv.config = timer_default_config;

    //set the period to 500us =  2kHz
    timer0_app_priv.time_us = 500;

    timer0_app_priv.event_cb = NULL;
}

void timer_event_handler (nrf_timer_event_t event_type, void* p_context){
    switch (event_type){
        case NRF_TIMER_EVENT_COMPARE0:
            timer0_app_priv.event_cb();
            LOG_DBG("timer app event triggered");
            break;
        default:
            break;
    }
}


void timer_init_app(void){
    timer_app_priv_set();
    nrfx_err_t err;

    //zephyr os, enalbe timer0 interrupt signal
    IRQ_DIRECT_CONNECT(TIMER0_IRQn, 0, nrfx_timer_0_irq_handler, 0);
    irq_enable(TIMER0_IRQn);

    err = nrfx_timer_init(&timer0_instance, &timer0_app_priv.config, timer_event_handler);
    if (err != NRFX_SUCCESS){
		LOG_ERR("nrfx_timer_init err(%x)", err);
		return;
	} 

    //get the tick of 500us
    uint32_t ticks = nrfx_timer_us_to_ticks(&timer0_instance, timer0_app_priv.time_us);
    LOG_DBG("timer ticks (%u)", ticks);

    

    //set channel 0 to compare mode
    nrfx_timer_extended_compare(&timer0_instance, NRF_TIMER_CC_CHANNEL0, ticks, NRF_TIMER_SHORT_COMPARE0_CLEAR_MASK, true);

    if (nrfx_timer_is_enabled(&timer0_instance)){
        nrfx_timer_disable(&timer0_instance);
        nrfx_timer_clear(&timer0_instance);
    }

    LOG_INF("timer initlization SUCCESS");
}

void timer_start_app(void){
    nrfx_timer_enable(&timer0_instance);
    if (nrfx_timer_is_enabled(&timer0_instance)){
        LOG_INF("timer START");
    }
}

void timer_stop_app(void){
    nrfx_timer_disable(&timer0_instance);
    nrfx_timer_clear(&timer0_instance);
}

void set_timer_app_cb(timer_app_cb_t event_cb){
    timer0_app_priv.event_cb = event_cb;
}

//function cast the gpio toggle into timer_app_cb_t
static void gpio_timer_cb (void){
    int err;
    err = gpio_pin_toggle(gpio0_dev,(gpio_pin_t)GPIO_PIN);
    if(err != 0){
        LOG_ERR("gpio toogle fail (%d)", err);
    }
}

void timer_test(void){
    while (!device_is_ready(gpio0_dev)){
        k_sleep(K_MSEC(1));
    }

    int err;
    err = gpio_pin_configure(gpio0_dev, (gpio_pin_t)GPIO_PIN, GPIO_OUTPUT);
    if (err != 0){
        LOG_DBG("GPIO pin config err (%d)", err);
    }

    timer_init_app();
	set_timer_app_cb(gpio_timer_cb);
	timer_start_app();
    while(1){
        k_sleep(K_SECONDS(1));
    }
}
```

## src/timer.h
```c
#pragma once
#include <zephyr.h>
#include <nrfx_timer.h>

typedef void (*timer_app_cb_t) (void);

typedef struct{
    nrfx_timer_config_t config;
    uint32_t time_us;
    timer_app_cb_t event_cb;
}timer_app_t;

/*@brief init timer for the application
*/
void timer_init_app(void);

/*@brief do not use this function in application
 *this function is use by the HAL driver as a timer interrupt event handler
*/
void timer_event_handler (nrf_timer_event_t event_type, void* p_context);

/*@biref start the timer 
*/
void timer_start_app(void);

/*@brief stop the timer
*/
void timer_stop_app(void);

/*@brief assign the application layer call back function of timer0 
*/
void set_timer_app_cb(timer_app_cb_t event_cb);

/*@brief test the timer
*/
void timer_test(void);
```
